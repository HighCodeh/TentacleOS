/**
 * @file mf_key_dict.c
 * @brief MIFARE key dictionary — built-in keys + NVS-backed user key storage.
 */

#include <string.h>
#include "esp_log.h"
#include "nvs.h"
#include "highboy_nfc_error.h"
#include "mf_key_dict.h"

static const char* TAG = "mf_key_dict";

/* -------------------------------------------------------------------------
 * Built-in key table
 * ------------------------------------------------------------------------- */
static const uint8_t s_builtin_keys[][6] = {
    { 0xFF, 0xFF, 0xFF, 0xFF, 0xFF, 0xFF },
    { 0x00, 0x00, 0x00, 0x00, 0x00, 0x00 },
    { 0xA0, 0xA1, 0xA2, 0xA3, 0xA4, 0xA5 },
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    { 0x7E, 0x85, 0x45, 0xCD, 0x23, 0xE4 },
};

const int MF_KEY_DICT_BUILTIN_COUNT =
    (int)(sizeof(s_builtin_keys) / sizeof(s_builtin_keys[0]));

/* -------------------------------------------------------------------------
 * Extra keys loaded from NVS
 * ------------------------------------------------------------------------- */
static uint8_t  s_extra_keys[MF_KEY_DICT_MAX_EXTRA][6];
static int      s_extra_count = 0;

#define NVS_NS          "nfc_dict"
#define NVS_KEY_COUNT   "extra_count"
#define NVS_KEY_PREFIX  "k_"

/* -------------------------------------------------------------------------
 * Public API
 * ------------------------------------------------------------------------- */

void mf_key_dict_init(void)
{
    s_extra_count = 0;

    nvs_handle_t handle;
    esp_err_t err = nvs_open(NVS_NS, NVS_READONLY, &handle);
    if (err != ESP_OK) {
        ESP_LOGW(TAG, "NVS open failed (0x%x), starting with empty extra keys", err);
        return;
    }

    uint8_t count = 0;
    err = nvs_get_u8(handle, NVS_KEY_COUNT, &count);
    if (err != ESP_OK || count == 0) {
        nvs_close(handle);
        return;
    }

    if (count > MF_KEY_DICT_MAX_EXTRA) {
        count = MF_KEY_DICT_MAX_EXTRA;
    }

    for (uint8_t i = 0; i < count; i++) {
        char key_name[16];
        snprintf(key_name, sizeof(key_name), NVS_KEY_PREFIX "%u", (unsigned)i);

        size_t len = 6;
        err = nvs_get_blob(handle, key_name, s_extra_keys[s_extra_count], &len);
        if (err == ESP_OK && len == 6) {
            s_extra_count++;
        } else {
            ESP_LOGW(TAG, "Failed to load key %s (err 0x%x)", key_name, err);
        }
    }

    nvs_close(handle);
    ESP_LOGI(TAG, "Loaded %d extra keys from NVS", s_extra_count);
}

int mf_key_dict_count(void)
{
    return MF_KEY_DICT_BUILTIN_COUNT + s_extra_count;
}

void mf_key_dict_get(int idx, uint8_t key_out[6])
{
    if (idx < 0) {
        return;
    }

    if (idx < MF_KEY_DICT_BUILTIN_COUNT) {
        memcpy(key_out, s_builtin_keys[idx], 6);
        return;
    }

    int extra_idx = idx - MF_KEY_DICT_BUILTIN_COUNT;
    if (extra_idx < s_extra_count) {
        memcpy(key_out, s_extra_keys[extra_idx], 6);
    }
}

bool mf_key_dict_contains(const uint8_t key[6])
{
    for (int i = 0; i < MF_KEY_DICT_BUILTIN_COUNT; i++) {
        if (memcmp(s_builtin_keys[i], key, 6) == 0) {
            return true;
        }
    }

    for (int i = 0; i < s_extra_count; i++) {
        if (memcmp(s_extra_keys[i], key, 6) == 0) {
            return true;
        }
    }

    return false;
}

hb_nfc_err_t mf_key_dict_add(const uint8_t key[6])
{
    if (s_extra_count >= MF_KEY_DICT_MAX_EXTRA) {
        ESP_LOGE(TAG, "Extra key dictionary is full (%d)", MF_KEY_DICT_MAX_EXTRA);
        return HB_NFC_ERR_INTERNAL;
    }

    if (mf_key_dict_contains(key)) {
        ESP_LOGD(TAG, "Key already in dictionary, skipping");
        return HB_NFC_OK;
    }

    memcpy(s_extra_keys[s_extra_count], key, 6);
    s_extra_count++;

    nvs_handle_t handle;
    esp_err_t err = nvs_open(NVS_NS, NVS_READWRITE, &handle);
    if (err != ESP_OK) {
        ESP_LOGE(TAG, "NVS open for write failed (0x%x)", err);
        s_extra_count--;
        return HB_NFC_ERR_INTERNAL;
    }

    char key_name[16];
    snprintf(key_name, sizeof(key_name), NVS_KEY_PREFIX "%d", s_extra_count - 1);

    err = nvs_set_blob(handle, key_name, key, 6);
    if (err != ESP_OK) {
        ESP_LOGE(TAG, "NVS set_blob failed (0x%x)", err);
        s_extra_count--;
        nvs_close(handle);
        return HB_NFC_ERR_INTERNAL;
    }

    err = nvs_set_u8(handle, NVS_KEY_COUNT, (uint8_t)s_extra_count);
    if (err != ESP_OK) {
        ESP_LOGE(TAG, "NVS set count failed (0x%x)", err);
    }

    nvs_commit(handle);
    nvs_close(handle);

    ESP_LOGI(TAG, "Added new key to dictionary (total extra: %d)", s_extra_count);
    return HB_NFC_OK;
}
