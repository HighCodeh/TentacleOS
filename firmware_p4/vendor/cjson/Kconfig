## firmware_p4/vendor/cjson/Kconfig
```kconfig
menu "cJSON"

    config CJSON_NESTING_LIMIT
        int "Maximum nesting depth for JSON parsing"
        default 1000
        help
            Limits how deeply nested arrays/objects can be before cJSON
            rejects to parse them. This is to prevent stack overflows.
            Lower values use less stack, higher values allow deeper nesting.

    config CJSON_CIRCULAR_LIMIT
        int "Maximum depth for circular reference detection"
        default 10000
        help
            Limits the depth for circular reference detection during
            printing/comparison operations. This prevents infinite loops
            and stack overflows when processing JSON structures with
            circular references. Lower values use less stack.

endmenu
```

## firmware_p4/vendor/libsodium/Kconfig
```kconfig
menu "libsodium"

    config LIBSODIUM_USE_MBEDTLS_SHA
        bool "Use mbedTLS SHA256 & SHA512 implementations"
        default y
        help
            If this option is enabled, libsodium will use thin wrappers
            around mbedTLS for SHA256 & SHA512 operations.
            This saves some code size if mbedTLS is also used.
endmenu # libsodium
```
